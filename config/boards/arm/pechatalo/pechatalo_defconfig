## config/boards/arm/pechatalo/pechatalo_defconfig
```kconfig
# Copyright (c) 2020 The ZMK Contributors
# SPDX-License-Identifier: MIT

CONFIG_SOC_SERIES_NRF52X=y
CONFIG_SOC_NRF52840_QIAA=y
CONFIG_BOARD_PECHATALO=y

# Enable MPU
CONFIG_ARM_MPU=y

# enable GPIO
CONFIG_GPIO=y

CONFIG_USE_DT_CODE_PARTITION=y
CONFIG_BUILD_OUTPUT_UF2=y

CONFIG_MPU_ALLOW_FLASH_WRITE=y
CONFIG_NVS=y
CONFIG_SETTINGS_NVS=y
CONFIG_FLASH=y
CONFIG_FLASH_PAGE_LAYOUT=y
CONFIG_FLASH_MAP=y

CONFIG_ZMK_BACKLIGHT=y
CONFIG_LED_GPIO=y
CONFIG_ZMK_BACKLIGHT_BRT_START=3
CONFIG_ZMK_BACKLIGHT_BRT_STEP=3

CONFIG_ZMK_USB_LOGGING=y
CONFIG_SERIAL=y
CONFIG_USB_DEVICE_STACK=y

CONFIG_USB_DEVICE_PRODUCT="Zephyr USB console sample"
CONFIG_USB_DEVICE_PID=0x0004
CONFIG_USB_DEVICE_INITIALIZE_AT_BOOT=n

CONFIG_UART_LINE_CTRL=y


CONFIG_STDOUT_CONSOLE=y

CONFIG_LOG=y
CONFIG_LOG_BACKEND_UART=y
CONFIG_CONSOLE=y
CONFIG_UART_CONSOLE=y
#CONFIG_LOG2_MODE_DEFERRED=y
#CONFIG_LOG_PRINTK=y"
CONFIG_USB_CDC_ACM_RINGBUF_SIZE=4096

CONFIG_PINCTRL=y
CONFIG_PWM_NRFX=y
CONFIG_PINCTRL_NRF=y

CONFIG_BT_CTLR_TX_PWR_PLUS_8=y

CONFIG_ZMK_BLE=y
CONFIG_ZMK_BLE_CLEAR_BONDS_ON_START=y

CONFIG_CLOCK_CONTROL_NRF_ACCURACY=500
CONFIG_CLOCK_CONTROL_NRF_K32SRC_50PPM=n
CONFIG_CLOCK_CONTROL_NRF_K32SRC_500PPM=y
```

## config/boards/pechatalo/west.yml
```yaml
manifest:
  remotes:
    - name: zmkfirmware
      url-base: https://github.com/zmkfirmware
    - name: pechatalo
      url-base: https://github.com/microsoft
  projects:
    - name: zmk
      remote: zmkfirmware
      revision: main
      import: app/west.yml
    - name: uf2
      remote: pechatalo
      path: tools/uf2
      clone-depth: 1
  self:
    path: config
```

## config/boards/shields/pechatalo/Kconfig.defconfig
```kconfig
# Copyright (c) 2020 The ZMK Contributors
# SPDX-License-Identifier: MIT

if PECHATALO

config ZMK_KEYBOARD_NAME
    default "pechatalo"

endif
```

## config/boards/shields/pechatalo/Kconfig.shield
```kconfig
# Copyright (c) 2020 The ZMK Contributors
# SPDX-License-Identifier: MIT

config PECHATALO
    def_bool $(shields_list_contains,pechatalo)
```

## config/west.yml
```yaml
manifest:
  remotes:
    - name: zmkfirmware
      url-base: https://github.com/zmkfirmware
    - name: microsoft
      url-base: https://github.com/microsoft
  projects:
    - name: zmk
      remote: zmkfirmware
      revision: main
      import: app/west.yml
    - name: uf2
      remote: microsoft
      path: tools/uf2
      clone-depth: 1
  self:
    path: config
```
